## config/boards/shields/wireless_preonic/Kconfig.defconfig
```kconfig
if SHIELD_WIRELESS_PREONIC

config ZMK_KEYBOARD_NAME
    default "Wireless Preonic"

endif
```

## config/boards/shields/wireless_preonic/Kconfig.shield
```kconfig
config SHIELD_WIRELESS_PREONIC
    def_bool $(shields_list_contains, wireless_preonic)
```
